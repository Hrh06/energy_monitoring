## Kconfig.projbuild
```kconfig
# ==================== Kconfig.projbuild ====================

menu "ESP32 Energy Meter Configuration"

    config ENERGY_METER_MQTT_BROKER_URL
        string "MQTT Broker URL"
        default "mqtts://your-broker.com"
        help
            MQTT broker URL with protocol (mqtts:// for SSL)

    config ENERGY_METER_MQTT_USERNAME
        string "MQTT Username"
        default "your_username"
        help
            Username for MQTT broker authentication

    config ENERGY_METER_MQTT_PASSWORD
        string "MQTT Password"
        default "your_password"
        help
            Password for MQTT broker authentication

    config ENERGY_METER_WIFI_SSID
        string "Default WiFi SSID"
        default "ESP32_Energy_Meter"
        help
            Default WiFi SSID for provisioning mode

    config ENERGY_METER_WIFI_PASSWORD
        string "Default WiFi Password"
        default "energy123"
        help
            Default WiFi password for provisioning mode

endmenu
```

## sdkconfig.defaults
```kconfig
# ESP32 Energy Meter - ESP-IDF v5.5 Compatible Configuration

# Flash Configuration
CONFIG_ESPTOOLPY_FLASHSIZE_4MB=y
CONFIG_PARTITION_TABLE_CUSTOM=y
CONFIG_PARTITION_TABLE_CUSTOM_FILENAME="partitions.csv"

# FreeRTOS Configuration  
CONFIG_FREERTOS_HZ=1000
CONFIG_FREERTOS_USE_TRACE_FACILITY=y

# Task Watchdog Configuration
CONFIG_ESP_TASK_WDT_EN=y
CONFIG_ESP_TASK_WDT_TIMEOUT_S=10
CONFIG_ESP_TASK_WDT_CHECK_IDLE_TASK_CPU0=y
CONFIG_ESP_TASK_WDT_CHECK_IDLE_TASK_CPU1=y

# Main Task Configuration
CONFIG_ESP_MAIN_TASK_STACK_SIZE=8192

# WiFi Configuration
CONFIG_ESP_WIFI_STATIC_RX_BUFFER_NUM=10
CONFIG_ESP_WIFI_DYNAMIC_RX_BUFFER_NUM=16
CONFIG_ESP_WIFI_DYNAMIC_TX_BUFFER_NUM=16
CONFIG_ESP_WIFI_AMPDU_TX_ENABLED=y
CONFIG_ESP_WIFI_AMPDU_RX_ENABLED=y

# LWIP Configuration
CONFIG_LWIP_TCP_MSS=1440
CONFIG_LWIP_TCP_SND_BUF_DEFAULT=65535
CONFIG_LWIP_TCP_WND_DEFAULT=65535

# MQTT Configuration
CONFIG_MQTT_PROTOCOL_311=y
CONFIG_MQTT_TRANSPORT_SSL=y
CONFIG_MQTT_TRANSPORT_WEBSOCKET=y
CONFIG_MQTT_TRANSPORT_WEBSOCKET_SECURE=y

# TLS/SSL Configuration
CONFIG_MBEDTLS_CERTIFICATE_BUNDLE=y
CONFIG_MBEDTLS_CERTIFICATE_BUNDLE_DEFAULT_FULL=y

# HTTP Server Configuration
CONFIG_HTTPD_MAX_REQ_HDR_LEN=1024
CONFIG_HTTPD_MAX_URI_LEN=512

# NVS Configuration
CONFIG_NVS_ENCRYPTION=y

# Logging Configuration
CONFIG_LOG_DEFAULT_LEVEL_INFO=y
CONFIG_LOG_COLORS=y

# Compiler Configuration
CONFIG_COMPILER_OPTIMIZATION_SIZE=y
CONFIG_COMPILER_CXX_EXCEPTIONS=n

# ESP-IDF v5.5 Specific Settings
CONFIG_ESP_SYSTEM_EVENT_TASK_STACK_SIZE=4096
CONFIG_ESP_TIMER_TASK_STACK_SIZE=4096

# Memory Configuration
CONFIG_ESP_DEFAULT_CPU_FREQ_MHZ_240=y
CONFIG_ESP_DEFAULT_CPU_FREQ_MHZ=240

# Serial Monitor Configuration  
CONFIG_ESPTOOLPY_MONITOR_BAUD_115200B=y
CONFIG_ESPTOOLPY_MONITOR_BAUD=115200
```
